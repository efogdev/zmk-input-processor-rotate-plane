## dts/bindings/input_processors/zmk,input-processor-rotate-plane.yaml
```yaml
# Copyright (c) 2024, The ZMK Contributors
# SPDX-License-Identifier: MIT

description: Input processor to rotate pointer plane
compatible: "zmk,input-processor-rotate-plane"
include: ip_zero_param.yaml

properties:
  type:
    type: int
  codes:
    type: array
    required: true
  angle:
    type: int
    required: true
  timeout:
    type: int
    required: true
  device-name:
    type: string
    required: true
```

## src/pointing/Kconfig
```kconfig
# Copyright (c) 2023 The ZMK Contributors
# SPDX-License-Identifier: MIT

if ZMK_POINTING

config ZMK_INPUT_PROCESSOR_ROTATE_PLANE
bool "Rotate plane input processor"
default y

if ZMK_INPUT_PROCESSOR_ROTATE_PLANE

config ZMK_INPUT_PROCESSOR_ROTATE_PLANE_TIMEOUT_MS
int "Timeout in milliseconds to wait for paired axis event"
default 16
help
  Time to wait for the second axis event before assuming it's 0.
  If only one axis event is received within this timeout, the other
  axis is assumed to be 0 for rotation calculation.

endif

endif
```

## src/shell/Kconfig
```kconfig
if SHELL

config ZMK_ROTATE_PLANE_SHELL
bool "Plane rotator shell commands"
default y

endif
```
